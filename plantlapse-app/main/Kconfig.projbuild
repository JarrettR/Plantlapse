## plantlapse-app/main/Kconfig.projbuild
```kconfig
menu "OTA Configuration"

    config FIRMWARE_UPGRADE_URL
        string "firmware upgrade url endpoint"
        default "http://192.168.0.3:8070/plantlapse-app/build/plantlapse.bin"
        help
            URL of server which hosts the firmware
            image.

    config FIRMWARE_UPGRADE_URL_FROM_STDIN
        bool
        default y if FIRMWARE_UPGRADE_URL = "FROM_STDIN"

    config SKIP_COMMON_NAME_CHECK
        bool "Skip server certificate CN fieldcheck"
        default n
        help
            This allows you to skip the validation of OTA server certificate CN field.

endmenu
menu "SD Card"

    config FORMAT_IF_MOUNT_FAILED
        bool "Format the card if mount failed"
        default n
        help
            If this config item is set, format_if_mount_failed will be set to true and the card will be formatted if
            the mount has failed.
endmenu
menu "Webserver Configuration"

    config MDNS_HOST_NAME
        string "mDNS Host Name"
        default "plantlapse"
        help
            Specify the domain name used in the mDNS service.
            Note that webpage also take it as a part of URL where it will send GET/POST requests to.
    config WEB_MOUNT_POINT
        string "Website mount point in VFS"
        default "/www"
        help
            Specify the mount point in VFS.

endmenu
```

## plantlapse-app/sdkconfig.defaults
```kconfig
CONFIG_ESPTOOLPY_FLASHSIZE_4MB=y
CONFIG_ESPTOOLPY_FLASHSIZE="4MB"
CONFIG_MDNS_HOST_NAME="plantlapse"
CONFIG_WEB_MOUNT_POINT="/sdcard"
CONFIG_FIRMWARE_UPGRADE_URL="http://192.168.0.10:8070/plantlapse-app/build/plantlapse.bin"
CONFIG_SKIP_COMMON_NAME_CHECK=y
CONFIG_ESP_HTTP_CLIENT_ENABLE_HTTPS=y
CONFIG_ESP_HTTP_CLIENT_ENABLE_DIGEST_AUTH=y
CONFIG_SPIRAM_SUPPORT=y
CONFIG_PARTITION_TABLE_CUSTOM=y
CONFIG_PARTITION_TABLE_CUSTOM_FILENAME="partitions.csv"
CONFIG_PARTITION_TABLE_FILENAME="partitions.csv"
CONFIG_FATFS_LFN_HEAP=y
CONFIG_OV2640_SUPPORT=y
CONFIG_GC2145_SUPPORT=n
CONFIG_GC032A_SUPPORT=n
CONFIG_GC0308_SUPPORT=n
CONFIG_BF3005_SUPPORT=n
CONFIG_BF20A6_SUPPORT=n
CONFIG_SC030IOT_SUPPORT=n
```
